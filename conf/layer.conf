## conf/layer.conf
```bitbake
# We have a conf and classes directory, add to BBPATH
BBPATH .= ":${LAYERDIR}"

# We have recipes-* directories, add to BBFILES
BBFILES += "${LAYERDIR}/recipes-*/*/*.bb \
            ${LAYERDIR}/recipes-*/*/*.bbappend"

BBFILE_COLLECTIONS += "machinekit"
BBFILE_PATTERN_machinekit = "^${LAYERDIR}/"
BBFILE_PRIORITY_machinekit = "5"
LAYERVERSION_machinekit = "1"
```
